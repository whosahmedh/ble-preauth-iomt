## CMakeLists.txt
```
cmake_minimum_required(VERSION 3.20.0)
find_package(Zephyr REQUIRED HINTS $ENV{ZEPHYR_BASE})
project(ble_preauth_iomt)

target_sources(app PRIVATE
    src/main.c
    src/auth_service.c
)

target_include_directories(app PRIVATE include)

target_sources(app PRIVATE
    src/main.c
    src/auth_service.c
    src/state_machine.c
)

target_sources(app PRIVATE
    src/main.c
    src/auth_service.c
    src/state_machine.c
    src/auth_protocol.c
)
```

## prj.conf
```kconfig
CONFIG_BT=y
CONFIG_BT_PERIPHERAL=y
CONFIG_BT_DEVICE_NAME="IoMT-PreAuth"
CONFIG_BT_SMP=y
CONFIG_BT_HCI=y
CONFIG_BT_H4=y
CONFIG_BT_EXT_ADV=n
CONFIG_BT_HCI_ACL_FLOW_CONTROL=n
CONFIG_BT_HCI_VS=n
CONFIG_BT_GAP_AUTO_UPDATE_CONN_PARAMS=n

CONFIG_BT_PRIVACY=n
CONFIG_BT_SMP_APP_PAIRING_ACCEPT=y
#CONFIG_LOG=y
#CONFIG_BT_SMP_LOG_LEVEL_DBG=y

#CONFIG_LOG=y
#CONFIG_BT_ATT_LOG_LEVEL_DBG=y
#CONFIG_BT_GATT_LOG_LEVEL_DBG=y
#CONFIG_BT_L2CAP_LOG_LEVEL_DBG=y

CONFIG_BT_BUF_ACL_RX_SIZE=255

CONFIG_SYSTEM_WORKQUEUE_STACK_SIZE=4096
CONFIG_BT_RX_STACK_SIZE=4096
CONFIG_ISR_STACK_SIZE=4096

CONFIG_ENTROPY_GENERATOR=y

# PSA Crypto provider and required ECDSA features
CONFIG_PSA_CRYPTO=y
CONFIG_PSA_WANT_ALG_ECDSA=y
CONFIG_PSA_WANT_ALG_SHA_256=y
CONFIG_PSA_WANT_ECC_SECP_R1_256=y
CONFIG_PSA_WANT_KEY_TYPE_ECC_PUBLIC_KEY=y

CONFIG_MAIN_STACK_SIZE=8192












#CONFIG_MBEDTLS=y
#CONFIG_MBEDTLS_BUILTIN=y
#CONFIG_MBEDTLS_ENTROPY_ENABLED=y
#CONFIG_MBEDTLS_PSA_CRYPTO_C=y
#CONFIG_PSA_WANT_ALG_ECDSA=y
#CONFIG_PSA_WANT_ALG_SHA_256=y
#CONFIG_PSA_WANT_ECC_SECP_R1_256=y
#CONFIG_PSA_WANT_KEY_TYPE_ECC_PUBLIC_KEY=y
```

## boards/nrf52840dk_nrf52840.overlay
```dts
/ {
    chosen {
        zephyr,bt-hci = &bt_hci_uart;
    };
};

&uart1 {
    status = "okay";
    bt_hci_uart: bt_hci_uart {
        compatible = "zephyr,bt-hci-uart";
        status = "okay";
    };
};
```

## src/main.c
```c
#include <zephyr/kernel.h>
#include <zephyr/bluetooth/bluetooth.h>
#include <zephyr/bluetooth/conn.h>
#include "auth_uuids.h"
#include "state_machine.h"
#include "auth_protocol.h"
#include <zephyr/bluetooth/conn.h>

#define DEVICE_NAME     CONFIG_BT_DEVICE_NAME
#define DEVICE_NAME_LEN (sizeof(DEVICE_NAME) - 1)

static const struct bt_data ad[] = {
    BT_DATA_BYTES(BT_DATA_FLAGS, (BT_LE_AD_GENERAL | BT_LE_AD_NO_BREDR)),
    BT_DATA_BYTES(BT_DATA_UUID128_ALL, BT_UUID_PREAUTH_SERVICE_VAL),
    BT_DATA(BT_DATA_NAME_COMPLETE, DEVICE_NAME, DEVICE_NAME_LEN),
};

static struct k_work adv_restart_work;

static void adv_restart_handler(struct k_work *work)
{
    int err = bt_le_adv_start(BT_LE_ADV_CONN_FAST_1, ad, ARRAY_SIZE(ad), NULL, 0);
    if (err) {
        printk("Failed to restart advertising (err %d)\n", err);
    } else {
        printk("Advertising restarted -- pre-auth GATT service discoverable\n");
    }
}

static void connected(struct bt_conn *conn, uint8_t err)
{
    if (err) {
        printk("Connection failed (err %u)\n", err);
        return;
    }
    state_machine_on_connected(conn);
}

static void disconnected(struct bt_conn *conn, uint8_t reason)
{
    printk("Disconnected (reason %u)\n", reason);
    state_machine_on_disconnected(conn);
}

BT_CONN_CB_DEFINE(conn_callbacks) = {
    .connected = connected,
    .disconnected = disconnected,
};

static void auth_cancel(struct bt_conn *conn)
{
    printk("[IoMT] Pairing cancelled\n");
}

static void auth_pairing_confirm(struct bt_conn *conn)
{
    if (state_machine_is_authenticated(conn)) {
        printk("[IoMT] Pairing confirmed -- connection is AUTHENTICATED\n");
        bt_conn_auth_pairing_confirm(conn);
    } else {
        printk("[IoMT] Pairing REJECTED -- connection not AUTHENTICATED\n");
        bt_conn_auth_cancel(conn);
    }
}

static enum bt_security_err auth_pairing_accept(struct bt_conn *conn,
                                                  const struct bt_conn_pairing_feat *const feat)
{
    if (state_machine_is_authenticated(conn)) {
        printk("[IoMT] Pairing request ACCEPTED -- connection is AUTHENTICATED\n");
        return BT_SECURITY_ERR_SUCCESS;
    }
    printk("[IoMT] Pairing request REJECTED -- connection not AUTHENTICATED\n");
    return BT_SECURITY_ERR_PAIR_NOT_ALLOWED;
}

static struct bt_conn_auth_cb conn_auth_callbacks = {
    .pairing_accept = auth_pairing_accept,
    .pairing_confirm = auth_pairing_confirm,
    .cancel = auth_cancel,
};

static void auth_pairing_complete(struct bt_conn *conn, bool bonded)
{
    printk("[IoMT] Pairing complete -- bonded: %s\n", bonded ? "yes" : "no");
    state_machine_on_bonded(conn);
}

static void auth_pairing_failed(struct bt_conn *conn, enum bt_security_err reason)
{
    printk("[IoMT] Pairing failed (reason %d)\n", reason);
}

static struct bt_conn_auth_info_cb conn_auth_info_callbacks = {
    .pairing_complete = auth_pairing_complete,
    .pairing_failed = auth_pairing_failed,
};

static void bt_ready(int err)
{
    if (err) {
        printk("Bluetooth init failed (err %d)\n", err);
        return;
    }
    printk("Bluetooth initialized\n");

    err = bt_le_adv_start(BT_LE_ADV_CONN_FAST_1, ad, ARRAY_SIZE(ad), NULL, 0);
    if (err) {
        printk("Advertising failed to start (err %d)\n", err);
        return;
    }
    printk("Advertising started -- pre-auth GATT service discoverable\n");
}

#define RUN_CRYPTO_SELFTEST 0

#if RUN_CRYPTO_SELFTEST
static void run_crypto_test_vectors(void)
{
    uint8_t test_nonce[32];
    for (int i = 0; i < 32; i++) {
        test_nonce[i] = i;
    }

    /* PASTE the 64-value C array printed by sign_test.py here */
        uint8_t valid_signature[64] = {
        0x79, 0x9c, 0xd4, 0x27, 0x33, 0x0e, 0x2d, 0x40, 0x6c, 0xdb, 0xe1, 0x89, 0xa8, 0xf7, 0x20, 0x8f,
        0x01, 0xe1, 0x11, 0x54, 0xf1, 0xf3, 0xb8, 0xcd, 0x77, 0x48, 0xd3, 0xb6, 0xd8, 0x80, 0x66, 0x06,
        0x76, 0x49, 0xd4, 0x8f, 0x96, 0x8d, 0x40, 0x67, 0x0b, 0xe4, 0x45, 0x58, 0xd3, 0xe7, 0x7c, 0xf9,
        0x12, 0x72, 0x18, 0x23, 0xb7, 0xf2, 0x15, 0xc6, 0x21, 0x03, 0x5d, 0x5d, 0x93, 0x39, 0x7c, 0x01
    };

    int64_t start = k_uptime_get();
    bool result1 = auth_protocol_verify_response(test_nonce, valid_signature, sizeof(valid_signature));
    int64_t elapsed = k_uptime_get() - start;
    printk("[TEST] Valid signature -> verify returned: %s (expect PASS)\n",
           result1 ? "PASS" : "FAIL");
    printk("[TEST] Verify took %lld ms\n", elapsed);

    uint8_t corrupted_signature[64];
    memcpy(corrupted_signature, valid_signature, sizeof(valid_signature));
    corrupted_signature[0] ^= 0xFF;  /* deliberately corrupt one byte */

    bool result2 = auth_protocol_verify_response(test_nonce, corrupted_signature, sizeof(corrupted_signature));
    printk("[TEST] Corrupted signature -> verify returned: %s (expect FAIL)\n",
           result2 ? "PASS" : "FAIL");
}
#endif

int main(void)
{
    state_machine_init();
    k_work_init(&adv_restart_work, adv_restart_handler);
    bt_conn_auth_cb_register(&conn_auth_callbacks);
    bt_conn_auth_info_cb_register(&conn_auth_info_callbacks);
    
    auth_protocol_init();
    #if RUN_CRYPTO_SELFTEST
        run_crypto_test_vectors();
    #endif

    int err = bt_enable(bt_ready);
    if (err) {
        printk("bt_enable failed (err %d)\n", err);
    }
    return 0;
}
```

## include/auth_protocol.h
```c
#ifndef AUTH_PROTOCOL_H
#define AUTH_PROTOCOL_H

#include <stdint.h>
#include <stddef.h>
#include <stdbool.h>

void auth_protocol_init(void);
bool auth_protocol_verify_response(const uint8_t *nonce, const uint8_t *signature, size_t sig_len);

#endif
```

## include/auth_uuids.h
```c
#ifndef AUTH_UUIDS_H
#define AUTH_UUIDS_H

#include <zephyr/bluetooth/uuid.h>

/* Replace every 0x######## group below with YOUR generated UUIDs.
   Example: a1b2c3d4-e5f6-7890-abcd-ef1234567890 becomes
   BT_UUID_128_ENCODE(0xa1b2c3d4, 0xe5f6, 0x7890, 0xabcd, 0xef1234567890) */

#define BT_UUID_PREAUTH_SERVICE_VAL \
    BT_UUID_128_ENCODE(0x3b442fd2, 0xed4b, 0x4606, 0xae27, 0x07669ee14818)

#define BT_UUID_CHALLENGE_VAL \
    BT_UUID_128_ENCODE(0xfc3c0cf7, 0x4ac7, 0x4d50, 0x9c75, 0x93ed1dac7e72)

#define BT_UUID_RESPONSE_VAL \
    BT_UUID_128_ENCODE(0x1742473b, 0xa085, 0x4cbb, 0xbd33, 0xc04d014c7239)

#define BT_UUID_AUTH_STATUS_VAL \
    BT_UUID_128_ENCODE(0x29d9276d, 0x30d5, 0x451e, 0x98b4, 0x509ae3dbf70e)

#define BT_UUID_SESSION_TOKEN_VAL \
    BT_UUID_128_ENCODE(0x5cf7b130, 0x3f16, 0x4cfa, 0xb7a4, 0xd40d852ebe64)

#define BT_UUID_PREAUTH_SERVICE   BT_UUID_DECLARE_128(BT_UUID_PREAUTH_SERVICE_VAL)
#define BT_UUID_CHALLENGE         BT_UUID_DECLARE_128(BT_UUID_CHALLENGE_VAL)
#define BT_UUID_RESPONSE          BT_UUID_DECLARE_128(BT_UUID_RESPONSE_VAL)
#define BT_UUID_AUTH_STATUS       BT_UUID_DECLARE_128(BT_UUID_AUTH_STATUS_VAL)
#define BT_UUID_SESSION_TOKEN     BT_UUID_DECLARE_128(BT_UUID_SESSION_TOKEN_VAL)

#endif
```

## include/programmer_pubkey.h
```c
#ifndef PROGRAMMER_PUBKEY_H
#define PROGRAMMER_PUBKEY_H

#include <stdint.h>

/* Programmer ECDSA P-256 public key, uncompressed point: 0x04 || X || Y */
static const uint8_t programmer_pubkey[65] = {
    0x04, 0xa2, 0x78, 0x2c, 0x0c, 0xc4, 0xd1, 0x5a, 0x7d, 0xd0, 0xc9, 0xf4, 0x67, 0x40, 0x00, 0x44, 0x15, 0x74, 0xbc, 0xd6, 0xe6, 0xb4, 0x91, 0xaf, 0x20, 0x8b, 0xae, 0x0c, 0x24, 0xfd, 0x82, 0x37, 0xca, 0xaa, 0x2c, 0xc0, 0x1d, 0x5a, 0xe8, 0x2d, 0x9f, 0x0e, 0x30, 0x00, 0x0b, 0xf7, 0xf9, 0x32, 0x99, 0x5e, 0x64, 0x34, 0x1f, 0xba, 0x4c, 0xc8, 0x70, 0x5f, 0xde, 0xb7, 0xa2, 0xa4, 0xae, 0xfd, 0x64
};

#endif
```

## include/state_machine.h
```c
#ifndef STATE_MACHINE_H
#define STATE_MACHINE_H

#include <zephyr/bluetooth/conn.h>
#include <stdint.h>
#include <stdbool.h>

void state_machine_init(void);
void state_machine_on_connected(struct bt_conn *conn);
void state_machine_on_disconnected(struct bt_conn *conn);
const uint8_t *state_machine_get_nonce(void);
bool state_machine_on_response(struct bt_conn *conn, const uint8_t *signature, uint16_t len);
const uint8_t *state_machine_get_session_token(void);
bool state_machine_is_authenticated(struct bt_conn *conn);
void state_machine_on_bonded(struct bt_conn *conn);

#endif
```

## src/auth_protocol.c
```c
#include <psa/crypto.h>
#include <zephyr/kernel.h>
#include <string.h>
#include "auth_protocol.h"
#include "programmer_pubkey.h"

#define PROGRAMMER_ID     "PROG0001"
#define PROGRAMMER_ID_LEN (sizeof(PROGRAMMER_ID) - 1)
#define NONCE_LEN 32
#define SIGNATURE_LEN 64  /* raw r || s for P-256, 32 bytes each */

void auth_protocol_init(void)
{
    psa_status_t status = psa_crypto_init();
    if (status != PSA_SUCCESS) {
        printk("[AuthProtocol] psa_crypto_init failed: %d\n", status);
    } else {
        printk("[AuthProtocol] PSA Crypto initialized\n");
    }
}

bool auth_protocol_verify_response(const uint8_t *nonce, const uint8_t *signature, size_t sig_len)
{
    if (sig_len != SIGNATURE_LEN) {
        printk("[AuthProtocol] Signature length %u != expected %d\n",
               (unsigned)sig_len, SIGNATURE_LEN);
        return false;
    }

    psa_key_attributes_t attributes = PSA_KEY_ATTRIBUTES_INIT;
    psa_set_key_type(&attributes, PSA_KEY_TYPE_ECC_PUBLIC_KEY(PSA_ECC_FAMILY_SECP_R1));
    psa_set_key_bits(&attributes, 256);
    psa_set_key_usage_flags(&attributes, PSA_KEY_USAGE_VERIFY_MESSAGE);
    psa_set_key_algorithm(&attributes, PSA_ALG_ECDSA(PSA_ALG_SHA_256));

    psa_key_id_t key_id;
    psa_status_t status = psa_import_key(&attributes, programmer_pubkey,
                                          sizeof(programmer_pubkey), &key_id);
    if (status != PSA_SUCCESS) {
        printk("[AuthProtocol] psa_import_key failed: %d\n", status);
        return false;
    }

    uint8_t message[NONCE_LEN + PROGRAMMER_ID_LEN];
    memcpy(message, nonce, NONCE_LEN);
    memcpy(message + NONCE_LEN, PROGRAMMER_ID, PROGRAMMER_ID_LEN);

    status = psa_verify_message(key_id, PSA_ALG_ECDSA(PSA_ALG_SHA_256),
                                 message, sizeof(message),
                                 signature, sig_len);

    psa_destroy_key(key_id);

    if (status == PSA_SUCCESS) {
        printk("[AuthProtocol] ECDSA verification: PASS\n");
        return true;
    }
    printk("[AuthProtocol] ECDSA verification: FAIL (status %d)\n", status);
    return false;
}
```

## src/auth_service.c
```c
#include <zephyr/kernel.h>
#include <zephyr/bluetooth/bluetooth.h>
#include <zephyr/bluetooth/gatt.h>
#include <zephyr/bluetooth/uuid.h>
#include <zephyr/bluetooth/att.h>
#include "auth_uuids.h"
#include "state_machine.h"

static ssize_t read_challenge(struct bt_conn *conn, const struct bt_gatt_attr *attr,
                               void *buf, uint16_t len, uint16_t offset)
{
    return bt_gatt_attr_read(conn, attr, buf, len, offset,
                              state_machine_get_nonce(), 32);
}

static ssize_t write_response(struct bt_conn *conn, const struct bt_gatt_attr *attr,
                               const void *buf, uint16_t len, uint16_t offset, uint8_t flags)
{
    state_machine_on_response(conn, (const uint8_t *)buf, len);
    return len;
}

static ssize_t read_session_token(struct bt_conn *conn, const struct bt_gatt_attr *attr,
                                   void *buf, uint16_t len, uint16_t offset)
{
    if (!state_machine_is_authenticated(conn)) {
        return BT_GATT_ERR(BT_ATT_ERR_AUTHORIZATION);
    }
    return bt_gatt_attr_read(conn, attr, buf, len, offset,
                              state_machine_get_session_token(), 32);
}

static void auth_status_ccc_cfg_changed(const struct bt_gatt_attr *attr, uint16_t value)
{
    printk("Auth Status notifications %s\n", value ? "enabled" : "disabled");
}

BT_GATT_SERVICE_DEFINE(preauth_svc,
    BT_GATT_PRIMARY_SERVICE(BT_UUID_PREAUTH_SERVICE),

    BT_GATT_CHARACTERISTIC(BT_UUID_CHALLENGE,
                            BT_GATT_CHRC_READ,
                            BT_GATT_PERM_READ,
                            read_challenge, NULL, NULL),

    BT_GATT_CHARACTERISTIC(BT_UUID_RESPONSE,
                            BT_GATT_CHRC_WRITE | BT_GATT_CHRC_WRITE_WITHOUT_RESP,
                            BT_GATT_PERM_WRITE,
                            NULL, write_response, NULL),

    BT_GATT_CHARACTERISTIC(BT_UUID_AUTH_STATUS,
                            BT_GATT_CHRC_NOTIFY,
                            0,
                            NULL, NULL, NULL),
    BT_GATT_CCC(auth_status_ccc_cfg_changed,
                BT_GATT_PERM_READ | BT_GATT_PERM_WRITE),

    BT_GATT_CHARACTERISTIC(BT_UUID_SESSION_TOKEN,
                            BT_GATT_CHRC_READ,
                            BT_GATT_PERM_READ,
                            read_session_token, NULL, NULL),
);
```

## src/state_machine.c
```c
#include <zephyr/kernel.h>
#include <zephyr/bluetooth/bluetooth.h>
#include <zephyr/bluetooth/conn.h>
#include <zephyr/random/random.h>
#include <string.h>
#include "state_machine.h"
#include "auth_protocol.h"

#define NONCE_LEN 32
#define SESSION_TOKEN_LEN 32
#define SESSION_TOKEN_TIMEOUT_MS (30 * 1000)

typedef enum {
    STATE_IDLE,
    STATE_CONNECTED_UNAUTH,
    STATE_CHALLENGE_SENT,
    STATE_VERIFYING,
    STATE_AUTHENTICATED,
    STATE_BONDED_SESSION,
    STATE_DISCONNECTED
} auth_state_t;

static auth_state_t current_state;
static uint8_t current_nonce[NONCE_LEN];
static uint8_t current_session_token[SESSION_TOKEN_LEN];
static struct bt_conn *authenticated_conn;
static struct k_timer session_timer;
static struct bt_conn *pending_disconnect_conn;
static struct k_work disconnect_work;

static void disconnect_work_handler(struct k_work *work)
{
    if (pending_disconnect_conn) {
        bt_conn_disconnect(pending_disconnect_conn, BT_HCI_ERR_REMOTE_USER_TERM_CONN);
        pending_disconnect_conn = NULL;
    }
}

static void reset_state(void)
{
    current_state = STATE_IDLE;
    memset(current_nonce, 0, sizeof(current_nonce));
    memset(current_session_token, 0, sizeof(current_session_token));
    authenticated_conn = NULL;
    k_timer_stop(&session_timer);
    printk("[IoMT] State: IDLE\n");
}

static void session_timer_expired(struct k_timer *timer)
{
    printk("[IoMT] Session token expired -> State: DISCONNECTED\n");
    current_state = STATE_DISCONNECTED;
    if (authenticated_conn) {
        pending_disconnect_conn = authenticated_conn;
        k_work_submit(&disconnect_work);
    }
}

void state_machine_init(void)
{
    k_timer_init(&session_timer, session_timer_expired, NULL);
    k_work_init(&disconnect_work, disconnect_work_handler);
    reset_state();
}

void state_machine_on_connected(struct bt_conn *conn)
{
    if (current_state != STATE_IDLE) {
        printk("[IoMT] Unexpected connection while not IDLE -> rejecting\n");
        bt_conn_disconnect(conn, BT_HCI_ERR_REMOTE_USER_TERM_CONN);
        return;
    }
    current_state = STATE_CONNECTED_UNAUTH;
    printk("[IoMT] Programmer connected -> State: CONNECTED_UNAUTH\n");

    sys_csrand_get(current_nonce, sizeof(current_nonce));
    current_state = STATE_CHALLENGE_SENT;
    printk("[IoMT] Nonce generated -> State: CHALLENGE_SENT\n");
}

void state_machine_on_disconnected(struct bt_conn *conn)
{
    printk("[IoMT] Disconnected\n");
    reset_state();
}

const uint8_t *state_machine_get_nonce(void)
{
    return current_nonce;
}

bool state_machine_on_response(struct bt_conn *conn, const uint8_t *signature, uint16_t len)
{
    if (current_state != STATE_CHALLENGE_SENT) {
        printk("[IoMT] Response received in wrong state -> rejecting\n");
        return false;
    }
    current_state = STATE_VERIFYING;
    printk("[IoMT] Response received -> State: VERIFYING\n");

    /* Placeholder verification -- real ECDSA check arrives in Phase 4.
       Any non-empty response is treated as PASS for now, purely so the
       state machine itself can be tested end-to-end before crypto exists. */
    bool verified = auth_protocol_verify_response(current_nonce, signature, len);

    if (!verified) {
        printk("[IoMT] Verification: FAIL -> State: DISCONNECTED\n");
        current_state = STATE_DISCONNECTED;
        pending_disconnect_conn = conn;
        k_work_submit(&disconnect_work);
        return false;
    }

    sys_csrand_get(current_session_token, sizeof(current_session_token));
    authenticated_conn = conn;
    current_state = STATE_AUTHENTICATED;
    k_timer_start(&session_timer, K_MSEC(SESSION_TOKEN_TIMEOUT_MS), K_NO_WAIT);
    printk("[IoMT] Verification: PASS -> Session token issued, State: AUTHENTICATED\n");
    return true;
}

const uint8_t *state_machine_get_session_token(void)
{
    return current_session_token;
}

bool state_machine_is_authenticated(struct bt_conn *conn)
{
    return (current_state == STATE_AUTHENTICATED || current_state == STATE_BONDED_SESSION)
           && authenticated_conn == conn;
}

void state_machine_on_bonded(struct bt_conn *conn)
{
    if (current_state != STATE_AUTHENTICATED || authenticated_conn != conn) {
        printk("[IoMT] Bond formed on unexpected connection -- ignoring\n");
        return;
    }
    k_timer_stop(&session_timer);
    current_state = STATE_BONDED_SESSION;
    printk("[IoMT] Bond formed\n");
    printk("[IoMT] State: BONDED_SESSION -- Secure session active\n");
}
```
